/dts-v1/;

/ {
	compatible = "brcm,bcm2835";

	fragment@0 {
		target = <0xffffffff>;

		__overlay__ {

			spi1_pins {
				brcm,pins = <0x13 0x14 0x15>;
				brcm,function = <0x03>;
				phandle = <0x01>;
			};

			spi1_cs_pins {
				brcm,pins = <0x12 0x11 0x10>;
				brcm,function = <0x01>;
				phandle = <0x02>;
			};
		};
	};

	fragment@1 {
		target = <0xffffffff>;

		__overlay__ {
			#address-cells = <0x01>;
			#size-cells = <0x00>;
			pinctrl-names = "default";
			pinctrl-0 = <0x01 0x02>;
			cs-gpios = <0xffffffff 0x12 0x01 0xffffffff 0x11 0x01 0xffffffff 0x10 0x01>;
			status = "okay";
			phandle = <0x03>;

            waveshare35a@0 {
                compatible = "ilitek,ili9486";
				reg = <0x00>;
				#address-cells = <0x01>;
				#size-cells = <0x00>;
                spi-max-frequency = <0x16e3600>;
				status = "okay";
				phandle = <0x04>;
                rotate = <0x5a>;
				bgr = <0x00>;
				fps = <0x1e>;
				buswidth = <0x08>;
				regwidth = <0x10>;
                dc-gpios = <0xffffffff 0x18 0x00>;
                reset-gpios = <0xffffffff 0x19 0x01>;
				debug = <0x00>;
				init = <0x10000b0 0x00 0x1000011 0x20000ff 0x100003a 0x55 0x1000036 0x28 0x10000c2 0x44 0x10000c5 0x00 0x00 0x00 0x00 0x10000e0 0x0f 0x1f 0x1c 0x0c 0x0f 0x08 0x48 0x98 0x37 0x0a 0x13 0x04 0x11 0x0d 0x00 0x10000e1 0x0f 0x32 0x2e 0x0b 0x0d 0x05 0x47 0x75 0x37 0x06 0x10 0x03 0x24 0x20 0x00 0x10000e2 0x0f 0x32 0x2e 0x0b 0x0d 0x05 0x47 0x75 0x37 0x06 0x10 0x03 0x24 0x20 0x00 0x1000036 0x28 0x1000011 0x1000029>;
            };

			spidev@1 {
				compatible = "spidev";
				reg = <0x01>;
				#address-cells = <0x01>;
				#size-cells = <0x00>;
				spi-max-frequency = <0x7735940>;
				status = "okay";
				phandle = <0x05>;
			};

            waveshare35a-ts@2 {
                compatible = "ti,ads7846";
				reg = <0x02>;
				#address-cells = <0x01>;
				#size-cells = <0x00>;
				status = "okay";
				phandle = <0x06>;
				spi-max-frequency = <0xc350>;
				ti,x-plate-ohms = [00 14];
				ti,pressure-max = [00 ff];
                interrupt-parent = <0xffffffff>;
                pendown-gpio = <0xffffffff 0x1A 0x01>;
                interrupts = <0x1A 0x02>;
            };
		};
	};

	fragment@2 {
		target = <0xffffffff>;

		__overlay__ {
			status = "okay";
		};
	};

    fragment@3 {
		target = <0xffffffff>;

		__overlay__ {
			status = "okay";

			spidev@0 {
				status = "disabled";
			};

			spidev@2 {
				status = "disabled";
			};
		};
	};

	__overrides__ {
		cs0_pin = [00 00 00 02 62 72 63 6d 2c 70 69 6e 73 3a 30 00 00 00 00 03 63 73 2d 67 70 69 6f 73 3a 34 00];
		cs1_pin = <0x02 0x6272636d 0x2c70696e 0x733a3400 0x03 0x63732d67 0x70696f73 0x3a313600>;
		cs2_pin = <0x02 0x6272636d 0x2c70696e 0x733a3800 0x03 0x63732d67 0x70696f73 0x3a323800>;
		cs0_spidev = [00 00 00 04 73 74 61 74 75 73 00];
		cs1_spidev = [00 00 00 05 73 74 61 74 75 73 00];
		cs2_spidev = [00 00 00 06 73 74 61 74 75 73 00];

        speed = <0x02 0x7370692d 0x6d61782d 0x66726571 0x75656e63 0x793a3000>;
		txbuflen = [00 00 00 02 74 78 62 75 66 6c 65 6e 3a 30 00];
		rotate = [00 00 00 02 72 6f 74 61 74 65 3a 30 00];
		fps = [00 00 00 02 66 70 73 3a 30 00];
		bgr = [00 00 00 02 62 67 72 3a 30 00];
		debug = <0x02 0x64656275 0x673a3000>;
		swapxy = <0x03 0x74692c73 0x7761702d 0x78793f00>;
	};

	__symbols__ {
		spi1_pins = "/fragment@0/__overlay__/spi1_pins";
		spi1_cs_pins = "/fragment@0/__overlay__/spi1_cs_pins";
		frag1 = "/fragment@1/__overlay__";
		spidev1_0 = "/fragment@3/__overlay__/spidev@0";
		spidev1_1 = "/fragment@1/__overlay__/spidev@1";
		spidev1_2 = "/fragment@3/__overlay__/spidev@2";
	};

	__fixups__ {
		gpio = "/fragment@0:target:0\0/fragment@1/__overlay__:cs-gpios:0\0/fragment@1/__overlay__:cs-gpios:12\0/fragment@1/__overlay__:cs-gpios:24\0/fragment@1/__overlay__/waveshare35a@0:reset-gpios:0\0/fragment@1/__overlay__/waveshare35a@0:dc-gpios:0\0/fragment@1/__overlay__/waveshare35a-ts@2:interrupt-parent:0\0/fragment@1/__overlay__/waveshare35a-ts@2:pendown-gpio:0\0";
		spi1 = "/fragment@1:target:0\0/fragment@3:target:0";
		aux = "/fragment@2:target:0";
	};

	__local_fixups__ {

		fragment@1 {

			__overlay__ {
				pinctrl-0 = <0x00 0x04>;
			};
		};

		__overrides__ {
			cs0_pin = <0x00 0x10>;
			cs1_pin = <0x00 0x10>;
			cs2_pin = <0x00 0x10>;
			cs0_spidev = <0x00>;
			cs1_spidev = <0x00>;
			cs2_spidev = <0x00>;

            speed = <0x00>;
			txbuflen = <0x00>;
			rotate = <0x00>;
			fps = <0x00>;
			bgr = <0x00>;
			debug = <0x00>;
			swapxy = <0x00>;
		};
	};
};
